## app/boards/shields/miniki/Kconfig.shield
```kconfig
# Copyright (c) 2020 Pete Johanson
# SPDX-License-Identifier: MIT

config SHIELD_MINIKI_LEFT
	def_bool $(shields_list_contains,miniki_left)

config SHIELD_MINIKI_RIGHT
	def_bool $(shields_list_contains,miniki_right)
```

## config/boards/shields/miniki/Kconfig.defconfig
```kconfig
if SHIELD_MINIKI_LEFT

config ZMK_KEYBOARD_NAME
	default "Miniki"

config ZMK_SPLIT_BLE_ROLE_CENTRAL
	default y

endif

if SHIELD_MINIKI_RIGHT

config ZMK_KEYBOARD_NAME
	default "Miniki Right"
	
endif

if SHIELD_MINIKI_LEFT || SHIELD_MINIKI_RIGHT

config ZMK_SPLIT
	default y
 
if ZMK_DISPLAY

config I2C
	default y

config SSD1306
	default y

config SSD1306_REVERSE_MODE
	default y

endif # ZMK_DISPLAY

endif
```
